## config/boards/arm/the50l/Kconfig.board
```kconfig
# Copyright (c) 2023 LAZYDESIGNERS
# SPDX-License-Identifier: MIT

config BOARD_THE50L
	bool "THE50L"
	depends on SOC_NRF52840_QIAA
```

## config/boards/arm/the50l/Kconfig.defconfig
```kconfig
# Copyright (c) 2023 LAZYDESIGNERS
# SPDX-License-Identifier: MIT

if BOARD_THE50L

config ZMK_KEYBOARD_NAME
	default "THE50L"

if USB_DEVICE_STACK

config USB_NRFX
	default y

endif # USB_DEVICE_STACK

config BT_CTLR
	default BT

config ZMK_BLE
	default y

config ZMK_USB
	default y

endif # BOARD_THE50L
```
